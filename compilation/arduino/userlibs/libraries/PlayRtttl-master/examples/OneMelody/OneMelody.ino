/*
 * RandomMelody.cpp
 *
 * Plays a melody from FLASH.
 *
 * More RTTTL songs can be found under http://www.picaxe.com/RTTTL-Ringtones-for-Tune-Command/
 *
 *  Copyright (C) 2019  Armin Joachimsmeyer
 *  armin.joachimsmeyer@gmail.com
 *
 *  This file is part of PlayRttl https://github.com/ArminJo/PlayRtttl.
 *
 *  PlayRttl is free software: you can redistribute it and/or modify
 *  it under the terms of the GNU General Public License as published by
 *  the Free Software Foundation, either version 3 of the License, or
 *  (at your option) any later version.
 *
 *  This program is distributed in the hope that it will be useful,
 *  but WITHOUT ANY WARRANTY; without even the implied warranty of
 *  MERCHANTABILITY or FITNESS FOR A PARTICULAR PURPOSE.  See the
 *  GNU General Public License for more details.
 *
 *  You should have received a copy of the GNU General Public License
 *  along with this program. If not, see <http://www.gnu.org/licenses/gpl.html>.
 *
 */

#include <Arduino.h>

//#define USE_NO_RTX_EXTENSIONS // Disables RTX format definitions `'s'` (style) and `'l'` (loop). Saves up to 332 bytes program memory
#include <PlayRtttl.hpp>

#if defined(__AVR_ATtiny25__) || defined(__AVR_ATtiny45__) || defined(__AVR_ATtiny85__) || defined(__AVR_ATtiny87__) || defined(__AVR_ATtiny167__)
#define TINY_SERIAL_INHERIT_FROM_PRINT
#include "ATtinySerialOut.hpp" // Available as Arduino library "ATtinySerialOut"
#undef LED_BUILTIN
#define LED_BUILTIN PB1  // on my digispark board
/*
 * Only tone at pin1 and 4 are generated by hardware.
 * If generated by software, the millis() interrupt disturbs the tone generation on an 1 MHz ATtiny.
 */
const int TONE_PIN = 1; // use pin 1 (also used for internal LED :-( ) since pin 4 is connected to USB
#else
const int TONE_PIN = 11;
#endif

char StarWarsInRam[] =
        "StarWars:d=32,o=5,b=45,l=2,s=N:p,f#,f#,f#,8b.,8f#.6,e6,d#6,c#6,8b.6,16f#.6,e6,d#6,c#6,8b.6,16f#.6,e6,d#6,e6,8c#6";

void setup() {
    pinMode(LED_BUILTIN, OUTPUT);
    Serial.begin(115200);
#if defined(__AVR_ATmega32U4__) || defined(SERIAL_PORT_USBVIRTUAL) || defined(SERIAL_USB) /*stm32duino*/|| defined(USBCON) /*STM32_stm32*/|| defined(SERIALUSB_PID) || defined(ARDUINO_attiny3217)
    delay(4000); // To be able to connect Serial monitor after reset or power up and before first print out. Do not wait for an attached Serial Monitor!
#endif
#if defined(__AVR_ATtiny25__) || defined(__AVR_ATtiny45__) || defined(__AVR_ATtiny85__) || defined(__AVR_ATtiny87__) || defined(__AVR_ATtiny167__)
    MCUSR = 0;
#endif
    // Just to know which program is running on my Arduino
    Serial.println(F("START " __FILE__ " from " __DATE__ "\r\nUsing library version " VERSION_PLAY_RTTTL));

    /*
     * Play one melody
     */
    Serial.println(F("Play StarWars"));
    playRtttlBlocking(TONE_PIN, StarWarsInRam);
    delay(10000);
}

void loop() {
    /*
     * And all the other melodies, but use now the non blocking functions
     */
    const char * const*tSongPtr;
    /*
     * Regular -> 21 melodies
     * Tiny -> 6 melodies
     * Small -> 11 melodies
     */
#if defined(__AVR_ATtiny85__)
//    for (uint_fast8_t i = 1; i < ARRAY_SIZE_MELODIES_SMALL; ++i) {
    for (uint_fast8_t i = 1; i < ARRAY_SIZE_MELODIES_TINY; ++i) {
//        tSongPtr = &RTTTLMelodiesSmall[i];
        tSongPtr = &RTTTLMelodiesTiny[i];
#else
    for (uint_fast8_t i = 0; i < ARRAY_SIZE_MELODIES; ++i) {
        tSongPtr = &RTTTLMelodies[i];
#endif
        printNamePGMPGM(tSongPtr, &Serial);
        Serial.print(F("Index="));
        Serial.println(i);

        startPlayRtttlPGMPGM(TONE_PIN, tSongPtr);
        while (updatePlayRtttl()) {
            /*
             * your own code here...
             */
            delay(1);
        }
        delay(2000);
    }
    delay(20000);
}

